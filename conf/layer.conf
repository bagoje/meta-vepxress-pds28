## conf/layer.conf
```bitbake
# We have a conf and classes directory, add to BBPATH
BBPATH .= ":${LAYERDIR}"

# We have recipes-* directories, add to BBFILES
BBFILES += " \
	${LAYERDIR}/recipes-*/*/*.bb \
	${LAYERDIR}/recipes-*/*/*.bbappend \
	"

BBFILE_COLLECTIONS += "meta-vexpress-pds28"
BBFILE_PATTERN_meta-vexpress-pds28 = "^${LAYERDIR}/"
LAYERDEPENDS_meta-vexpress-pds28 = " \
	core \
"

LAYERSERIES_COMPAT_meta-vexpress-pds28 = "dunfell"
```
